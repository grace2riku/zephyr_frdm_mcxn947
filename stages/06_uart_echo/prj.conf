## CMakeLists.txt
```
# SPDX-License-Identifier: Apache-2.0

cmake_minimum_required(VERSION 3.20.0)

set(ECHO_MODE "byte" CACHE STRING "Echo lesson: byte, line or irq")
set_property(CACHE ECHO_MODE PROPERTY STRINGS byte line irq)

if(ECHO_MODE STREQUAL "irq")
  set(CONF_FILE "${CMAKE_CURRENT_SOURCE_DIR}/prj_irq.conf")
else()
  set(CONF_FILE "${CMAKE_CURRENT_SOURCE_DIR}/prj.conf")
endif()

find_package(Zephyr REQUIRED HINTS $ENV{ZEPHYR_BASE})
project(uart_echo)

if(ECHO_MODE STREQUAL "byte")
  target_sources(app PRIVATE src/main.c)
elseif(ECHO_MODE STREQUAL "line")
  target_sources(app PRIVATE src/poll_line.c)
elseif(ECHO_MODE STREQUAL "irq")
  target_sources(app PRIVATE src/irq_line.c)
else()
  message(FATAL_ERROR "ECHO_MODE must be byte, line or irq")
endif()

message(STATUS "Stage 6 ECHO_MODE=${ECHO_MODE}")
```

## prj.conf
```kconfig
# SPDX-License-Identifier: Apache-2.0
# ポーリング版共通：mainだけがUARTを読む。文字／行単位はCMakeで選ぶ。
CONFIG_SERIAL=y
CONFIG_UART_INTERRUPT_DRIVEN=n
CONFIG_UART_ASYNC_API=n

# chosenのUARTノードは利用するが、コンソール・shellの処理は使わない。
CONFIG_CONSOLE=n
CONFIG_UART_CONSOLE=n
CONFIG_CONSOLE_SUBSYS=n
CONFIG_SHELL=n
CONFIG_PRINTK=n
CONFIG_LOG=n
CONFIG_BOOT_BANNER=n

CONFIG_MULTITHREADING=y
CONFIG_MAIN_THREAD_PRIORITY=6
CONFIG_MAIN_STACK_SIZE=2048
```

## prj_irq.conf
```kconfig
# SPDX-License-Identifier: Apache-2.0
# 割り込み版：UARTの受信担当はISR、送信担当はmain。
CONFIG_SERIAL=y
CONFIG_UART_INTERRUPT_DRIVEN=y
CONFIG_UART_ASYNC_API=n
CONFIG_GPIO=y

CONFIG_CONSOLE=n
CONFIG_UART_CONSOLE=n
CONFIG_CONSOLE_SUBSYS=n
CONFIG_SHELL=n
CONFIG_PRINTK=n
CONFIG_LOG=n
CONFIG_BOOT_BANNER=n

CONFIG_MULTITHREADING=y
CONFIG_MAIN_THREAD_PRIORITY=6
CONFIG_MAIN_STACK_SIZE=2048
```

## src/main.c
```c
/* SPDX-License-Identifier: Apache-2.0 */

#include <zephyr/device.h>
#include <zephyr/devicetree.h>
#include <zephyr/drivers/uart.h>
#include <zephyr/kernel.h>

#define UART_NODE DT_CHOSEN(zephyr_console)

#if !DT_NODE_HAS_STATUS(UART_NODE, okay)
#error "zephyr,console must refer to an enabled UART node"
#endif

static const struct device *const uart_dev = DEVICE_DT_GET(UART_NODE);

/* printkを経由せず、指定したバイトを直接送る。終端NULは送らない。 */
static void uart_send_string(const char *text)
{
	while (*text != '\0') {
		uart_poll_out(uart_dev, (unsigned char)*text++);
	}
}

int main(void)
{
	if (!device_is_ready(uart_dev)) {
		/* UARTが未準備なら、このUARTへエラー表示することもできない。 */
		return 0;
	}

	uart_send_string("Stage 6: polling byte echo\r\n");
	uart_send_string("Local echo OFF; each received byte is returned unchanged.\r\n");

	while (1) {
		unsigned char c;
		int ret = uart_poll_in(uart_dev, &c);

		if (ret == 0) {
			/* 成功したときだけcを使う。CR/LFもそのまま返す。 */
			uart_poll_out(uart_dev, c);
		} else if (ret == -1) {
			/* API自身は受信を待たない。空ならmainを短時間休ませる。 */
			k_msleep(1);
		} else {
			uart_send_string("\r\nERROR: uart_poll_in failed; main exits.\r\n");
			return 0;
		}
	}
}
```

## src/irq_line.c
```c
/* SPDX-License-Identifier: Apache-2.0 */

#include <stdbool.h>
#include <stddef.h>
#include <stdint.h>

#include <zephyr/device.h>
#include <zephyr/devicetree.h>
#include <zephyr/drivers/gpio.h>
#include <zephyr/drivers/uart.h>
#include <zephyr/kernel.h>
#include <zephyr/sys/atomic.h>

#define UART_NODE DT_CHOSEN(zephyr_console)
#define LED_NODE DT_ALIAS(led0)
#define LINE_BUFFER_SIZE 32
#define RX_QUEUE_DEPTH 10
#define LED_STACK_SIZE 2048
#define LED_PRIORITY 5
#define LED_INTERVAL_MS 250

#if !DT_NODE_HAS_STATUS(UART_NODE, okay)
#error "zephyr,console must refer to an enabled UART node"
#endif
#if !DT_NODE_HAS_STATUS(LED_NODE, okay)
#error "led0 must refer to an enabled LED node"
#endif

enum line_result {
	LINE_OK,
	LINE_TOO_LONG,
	LINE_INVALID_BYTE,
	LINE_UART_ERROR,
};

struct line_message {
	enum line_result result;
	int uart_errors;
	char text[LINE_BUFFER_SIZE];
};

static const struct device *const uart_dev = DEVICE_DT_GET(UART_NODE);
static const struct gpio_dt_spec led = GPIO_DT_SPEC_GET(LED_NODE, gpios);

/* 完成した行（エラーも含む）をコピーして最大10件保持する。 */
K_MSGQ_DEFINE(rx_queue, sizeof(struct line_message), RX_QUEUE_DEPTH, 4);
K_THREAD_STACK_DEFINE(led_stack, LED_STACK_SIZE);
static struct k_thread led_thread;

/* UARTを有効化した後、以下の受信状態はISRだけが更新する。 */
static struct line_message rx_line;
static size_t rx_len;
static bool previous_was_cr;

/* ISR／LEDスレッドとmainの間で共有する通知だけをatomicにする。 */
static atomic_t queue_overflow;
static atomic_t led_failed;

/* この関数を呼ぶのはmainだけ。ISRとLEDスレッドから送信しない。 */
static void uart_send_string(const char *text)
{
	while (*text != '\0') {
		uart_poll_out(uart_dev, (unsigned char)*text++);
	}
}

static void record_rx_errors(const struct device *dev)
{
	int flags = uart_err_check(dev);

	/* このAPIの実装有無は、mainで割り込み有効化前に確認する。 */
	if (flags > 0) {
		rx_line.result = LINE_UART_ERROR;
		rx_line.uart_errors |= flags;
		rx_len = 0;
		previous_was_cr = false;
	}
}

static void receive_byte(uint8_t c)
{
	if (c == '\n' && previous_was_cr) {
		previous_was_cr = false;
		return;
	}
	previous_was_cr = (c == '\r');

	if (c == '\r' || c == '\n') {
		rx_line.text[rx_len] = '\0';
		/* ISRでは待たない。満杯なら今回の完成行を捨てる。 */
		if (k_msgq_put(&rx_queue, &rx_line, K_NO_WAIT) != 0) {
			atomic_set(&queue_overflow, 1);
		}
		/* キューはデータをコピーするため、このバッファを再利用できる。 */
		rx_len = 0;
		rx_line.result = LINE_OK;
		rx_line.uart_errors = 0;
		return;
	}
	if (rx_line.result != LINE_OK) {
		return;
	}
	if (c < 0x20 || c > 0x7e) {
		rx_line.result = LINE_INVALID_BYTE;
		return;
	}
	if (rx_len >= sizeof(rx_line.text) - 1) {
		rx_line.result = LINE_TOO_LONG;
		return;
	}
	rx_line.text[rx_len++] = (char)c;
}

/* MCUX UARTドライバのISRから呼ばれる。ここでは送信・sleepをしない。 */
static void serial_cb(const struct device *dev, void *user_data)
{
	uint8_t c;

	ARG_UNUSED(user_data);
	if (uart_irq_update(dev) <= 0) {
		return;
	}
	/* データなしのエラー割り込みでもフラグを確認・解除する。 */
	record_rx_errors(dev);
	if (uart_irq_rx_ready(dev) <= 0) {
		return;
	}
	while (uart_fifo_read(dev, &c, 1) == 1) {
		record_rx_errors(dev);
		receive_byte(c);
	}
}

static void led_entry(void *p1, void *p2, void *p3)
{
	int logical = 0;

	ARG_UNUSED(p1);
	ARG_UNUSED(p2);
	ARG_UNUSED(p3);
	while (1) {
		int next = !logical;

		if (gpio_pin_set_dt(&led, next) < 0) {
			atomic_set(&led_failed, 1);
			return;
		}
		logical = next;
		k_msleep(LED_INTERVAL_MS);
	}
}

static void send_message(const struct line_message *message)
{
	switch (message->result) {
	case LINE_OK:
		uart_send_string("Echo: ");
		uart_send_string(message->text);
		uart_send_string("\r\n");
		break;
	case LINE_TOO_LONG:
		uart_send_string("ERROR: line too long (max 31 bytes); discarded\r\n");
		break;
	case LINE_INVALID_BYTE:
		uart_send_string("ERROR: printable ASCII only; line discarded\r\n");
		break;
	case LINE_UART_ERROR:
		if (message->uart_errors & UART_ERROR_OVERRUN) {
			uart_send_string("ERROR: UART RX overrun; line discarded\r\n");
		} else {
			uart_send_string("ERROR: UART RX error; line discarded\r\n");
		}
		break;
	}
}

int main(void)
{
	struct line_message message;
	int ret;

	if (!device_is_ready(uart_dev)) {
		return 0;
	}
	if (!gpio_is_ready_dt(&led) ||
	    gpio_pin_configure_dt(&led, GPIO_OUTPUT_INACTIVE) < 0) {
		uart_send_string("ERROR: LED setup failed; main exits.\r\n");
		return 0;
	}
	if (uart_err_check(uart_dev) < 0) {
		uart_send_string("ERROR: uart_err_check unavailable; main exits.\r\n");
		return 0;
	}
	ret = uart_irq_callback_user_data_set(uart_dev, serial_cb, NULL);
	if (ret < 0) {
		uart_send_string("ERROR: UART IRQ callback setup failed; main exits.\r\n");
		return 0;
	}

	k_thread_create(&led_thread, led_stack, K_THREAD_STACK_SIZEOF(led_stack),
			led_entry, NULL, NULL, NULL, LED_PRIORITY, 0, K_FOREVER);
	k_thread_start(&led_thread);

	uart_send_string("Stage 6: interrupt line echo\r\n");
	uart_send_string("Local echo OFF; max 31 printable ASCII bytes; queue depth=10.\r\n");
	uart_send_string("LED toggle interval=250 ms; main waits for completed lines.\r\n");
	uart_irq_rx_enable(uart_dev);
	uart_irq_err_enable(uart_dev);

	while (k_msgq_get(&rx_queue, &message, K_FOREVER) == 0) {
		if (atomic_clear(&queue_overflow) != 0) {
			uart_send_string("ERROR: RX queue full; one or more lines discarded\r\n");
		}
		if (atomic_clear(&led_failed) != 0) {
			uart_send_string("ERROR: LED write failed; LED thread stopped\r\n");
		}
		send_message(&message);
	}
	return 0;
}
```

## src/poll_line.c
```c
/* SPDX-License-Identifier: Apache-2.0 */

#include <stdbool.h>
#include <stddef.h>

#include <zephyr/device.h>
#include <zephyr/devicetree.h>
#include <zephyr/drivers/uart.h>
#include <zephyr/kernel.h>

#define UART_NODE DT_CHOSEN(zephyr_console)
#define LINE_BUFFER_SIZE 32

#if !DT_NODE_HAS_STATUS(UART_NODE, okay)
#error "zephyr,console must refer to an enabled UART node"
#endif

static const struct device *const uart_dev = DEVICE_DT_GET(UART_NODE);

enum line_error {
	LINE_OK,
	LINE_TOO_LONG,
	LINE_INVALID_BYTE,
	LINE_UART_ERROR,
};

/* 受信状態の読み書きはmainだけが行う。1 Bは終端NUL用に残す。 */
static char line_buf[LINE_BUFFER_SIZE];
static size_t line_len;
static enum line_error pending_error;
static bool previous_was_cr;
static int rx_error_flags;

static void uart_send_string(const char *text)
{
	while (*text != '\0') {
		uart_poll_out(uart_dev, (unsigned char)*text++);
	}
}

static bool check_rx_errors(void)
{
	/* 採用MCUXドライバはエラーフラグの取得と解除をここで行う。 */
	int flags = uart_err_check(uart_dev);

	if (flags < 0) {
		uart_send_string("\r\nERROR: uart_err_check failed; main exits.\r\n");
		return false;
	}
	if (flags != 0) {
		/* 欠落の可能性がある行は返さず、次の行終端まで捨てる。 */
		rx_error_flags |= flags;
		pending_error = LINE_UART_ERROR;
		line_len = 0;
		previous_was_cr = false;
	}
	return true;
}

static void process_byte(unsigned char c)
{
	/* CRLFのLFだけを省く。CR単独・LF単独はそれぞれ行の終端。 */
	if (c == '\n' && previous_was_cr) {
		previous_was_cr = false;
		return;
	}
	previous_was_cr = (c == '\r');

	if (c == '\r' || c == '\n') {
		if (pending_error == LINE_UART_ERROR) {
			if (rx_error_flags & UART_ERROR_OVERRUN) {
				uart_send_string("ERROR: UART RX overrun; line discarded\r\n");
			} else {
				uart_send_string("ERROR: UART RX error; line discarded\r\n");
			}
		} else if (pending_error == LINE_TOO_LONG) {
			uart_send_string("ERROR: line too long (max 31 bytes); discarded\r\n");
		} else if (pending_error == LINE_INVALID_BYTE) {
			uart_send_string("ERROR: printable ASCII only; line discarded\r\n");
		} else {
			line_buf[line_len] = '\0';
			uart_send_string("Echo: ");
			uart_send_string(line_buf);
			uart_send_string("\r\n");
		}
		line_len = 0;
		pending_error = LINE_OK;
		rx_error_flags = 0;
		return;
	}

	/* 異常を検出した行は、終端が届くまで残りを捨てる。 */
	if (pending_error != LINE_OK) {
		return;
	}
	if (c < 0x20 || c > 0x7e) {
		/* NULやBackspaceも受け付けず、文字列の途中終了を防ぐ。 */
		pending_error = LINE_INVALID_BYTE;
		return;
	}
	if (line_len >= sizeof(line_buf) - 1) {
		pending_error = LINE_TOO_LONG;
		return;
	}
	line_buf[line_len++] = (char)c;
}

int main(void)
{
	if (!device_is_ready(uart_dev)) {
		return 0;
	}

	uart_send_string("Stage 6: polling line echo\r\n");
	uart_send_string("Local echo OFF; max 31 printable ASCII bytes; CR/LF ends a line.\r\n");
	uart_send_string("RX error recovery enabled.\r\n");

	while (1) {
		unsigned char c;
		int ret;

		if (!check_rx_errors()) {
			return 0;
		}
		ret = uart_poll_in(uart_dev, &c);

		if (ret == 0) {
			/* 直前の検査と読出しの間に発生したエラーも確認する。 */
			if (!check_rx_errors()) {
				return 0;
			}
			process_byte(c);
		} else if (ret == -1) {
			k_msleep(1);
		} else {
			uart_send_string("\r\nERROR: uart_poll_in failed; main exits.\r\n");
			return 0;
		}
	}
}
```
