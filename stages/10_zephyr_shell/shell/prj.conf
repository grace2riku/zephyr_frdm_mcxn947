## CMakeLists.txt
```
# SPDX-License-Identifier: Apache-2.0
cmake_minimum_required(VERSION 3.20.0)
find_package(Zephyr REQUIRED HINTS $ENV{ZEPHYR_BASE})
project(stage10_shell)

target_sources(app PRIVATE src/main.c src/led_control.c)
```

## prj.conf
```kconfig
# Standard Shell owns UART input in this separate application.
CONFIG_SERIAL=y
CONFIG_CONSOLE=y
CONFIG_UART_CONSOLE=y
CONFIG_SHELL=y
CONFIG_SHELL_BACKEND_SERIAL=y
CONFIG_SHELL_PROMPT_UART="zephyr> "

# Application controls led0 through the GPIO API.
CONFIG_GPIO=y
CONFIG_LED_GPIO=n

# Do not start Console character/line input alongside Shell.
CONFIG_CONSOLE_SUBSYS=n
CONFIG_CONSOLE_HANDLER=n
CONFIG_LOG=n
```

## src/main.c
```c
/* SPDX-License-Identifier: Apache-2.0 */
#include <errno.h>
#include <zephyr/shell/shell.h>
#include <zephyr/sys/util.h>

#include "led_control.h"

static int apply_led(const struct shell *sh, enum led_mode mode, uint32_t interval_ms)
{
	int ret = led_control_take_error();

	if (ret < 0) {
		shell_error(sh, "Previous blink stopped after GPIO error: %d", ret);
	}

	ret = led_control_apply(mode, interval_ms);
	if (ret < 0) {
		shell_error(sh, "LED request failed: %d", ret);
		return ret;
	}

	if (mode == LED_BLINK) {
		shell_print(sh, "LED BLINK toggle_ms=%u", (unsigned int)interval_ms);
	} else {
		shell_print(sh, "LED %s", mode == LED_ON ? "ON" : "OFF");
	}
	return 0;
}

static int cmd_led_on(const struct shell *sh, size_t argc, char **argv)
{
	ARG_UNUSED(argc);
	ARG_UNUSED(argv);
	return apply_led(sh, LED_ON, LED_BLINK_DEFAULT_MS);
}

static int cmd_led_off(const struct shell *sh, size_t argc, char **argv)
{
	ARG_UNUSED(argc);
	ARG_UNUSED(argv);
	return apply_led(sh, LED_OFF, LED_BLINK_DEFAULT_MS);
}

static int cmd_led_blink(const struct shell *sh, size_t argc, char **argv)
{
	int err = 0;
	unsigned long interval_ms = shell_strtoul(argv[1], 10, &err);

	ARG_UNUSED(argc);
	if (err != 0 || interval_ms < LED_BLINK_MIN_MS || interval_ms > LED_BLINK_MAX_MS) {
		shell_error(sh, "Use: led blink <100..2000 ms>");
		return -EINVAL;
	}
	return apply_led(sh, LED_BLINK, (uint32_t)interval_ms);
}

SHELL_STATIC_SUBCMD_SET_CREATE(led_commands,
	SHELL_CMD_ARG(on, NULL, "Turn the red LED on.", cmd_led_on, 1, 0),
	SHELL_CMD_ARG(off, NULL, "Turn the red LED off.", cmd_led_off, 1, 0),
	SHELL_CMD_ARG(blink, NULL, "Blink: toggle interval in ms (100..2000).",
		      cmd_led_blink, 2, 0),
	SHELL_SUBCMD_SET_END
);

SHELL_CMD_REGISTER(led, &led_commands, "Control the red LED.", NULL);

static int cmd_hello(const struct shell *sh, size_t argc, char **argv)
{
	ARG_UNUSED(argc);
	ARG_UNUSED(argv);

	shell_print(sh, "Hello from Zephyr Shell.");
	return 0;
}

SHELL_CMD_ARG_REGISTER(hello, NULL, "Print a greeting.", cmd_hello, 1, 0);

int main(void)
{
	/* Shell runs in its own thread. */
	return 0;
}
```

## src/led_control.c
```c
/* SPDX-License-Identifier: Apache-2.0 */
#include <errno.h>
#include <stdbool.h>
#include <zephyr/drivers/gpio.h>
#include <zephyr/kernel.h>
#include <zephyr/sys/atomic.h>

#include "led_control.h"

static const struct gpio_dt_spec led = GPIO_DT_SPEC_GET(DT_ALIAS(led0), gpios);

struct led_request {
	enum led_mode mode;
	uint32_t interval_ms;
};

K_MSGQ_DEFINE(led_requests, sizeof(struct led_request), 1, 4);
K_SEM_DEFINE(led_done, 0, 1);
K_THREAD_STACK_DEFINE(led_stack, 2048);
static struct k_thread led_thread;
static int request_result;
static bool initialized;
static atomic_t blink_error;

/* After initial configuration, only this thread updates GPIO and mode. */
static void led_entry(void *p1, void *p2, void *p3)
{
	struct led_request request;
	enum led_mode mode = LED_OFF;
	uint32_t interval_ms = LED_BLINK_DEFAULT_MS;
	int logical = 0;

	ARG_UNUSED(p1);
	ARG_UNUSED(p2);
	ARG_UNUSED(p3);

	while (1) {
		int ret = k_msgq_get(&led_requests, &request,
			mode == LED_BLINK ? K_MSEC(interval_ms) : K_FOREVER);

		if (ret == 0) {
			int next = request.mode != LED_OFF;

			request_result = gpio_pin_set_dt(&led, next);
			if (request_result == 0) {
				logical = next;
				mode = request.mode;
				interval_ms = request.interval_ms;
			} else {
				mode = LED_OFF;
			}
			k_sem_give(&led_done);
		} else if (ret == -EAGAIN && mode == LED_BLINK) {
			ret = gpio_pin_set_dt(&led, !logical);
			if (ret == 0) {
				logical = !logical;
			} else {
				atomic_set(&blink_error, ret);
				mode = LED_OFF;
			}
		}
	}
}

/* Called lazily by the single Shell handler before the worker is started. */
static int led_control_init(void)
{
	int ret;

	if (!gpio_is_ready_dt(&led)) {
		return -ENODEV;
	}
	ret = gpio_pin_configure_dt(&led, GPIO_OUTPUT_INACTIVE);
	if (ret < 0) {
		return ret;
	}
	k_thread_create(&led_thread, led_stack, K_THREAD_STACK_SIZEOF(led_stack),
		led_entry, NULL, NULL, NULL, 5, 0, K_NO_WAIT);
	initialized = true;
	return 0;
}

int led_control_apply(enum led_mode mode, uint32_t interval_ms)
{
	struct led_request request = {mode, interval_ms};
	int ret;

	if ((mode != LED_OFF && mode != LED_ON && mode != LED_BLINK) ||
	    (mode == LED_BLINK && (interval_ms < LED_BLINK_MIN_MS ||
				  interval_ms > LED_BLINK_MAX_MS))) {
		return -EINVAL;
	}
	if (!initialized) {
		ret = led_control_init();
		if (ret < 0) {
			return ret;
		}
	}
	ret = k_msgq_put(&led_requests, &request, K_NO_WAIT);
	if (ret != 0) {
		return ret;
	}
	k_sem_take(&led_done, K_FOREVER);
	return request_result;
}

int led_control_take_error(void)
{
	return (int)atomic_clear(&blink_error);
}
```

## src/led_control.h
```c
/* SPDX-License-Identifier: Apache-2.0 */
#ifndef STAGE10_LED_CONTROL_H
#define STAGE10_LED_CONTROL_H

#include <stdint.h>

#define LED_BLINK_MIN_MS 100U
#define LED_BLINK_MAX_MS 2000U
#define LED_BLINK_DEFAULT_MS 500U

enum led_mode { LED_OFF, LED_ON, LED_BLINK };

/* Shell handler only. Wait for GPIO application, not a blink interval. */
int led_control_apply(enum led_mode mode, uint32_t interval_ms);
int led_control_take_error(void);

#endif
```
