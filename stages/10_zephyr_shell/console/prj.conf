## CMakeLists.txt
```
# SPDX-License-Identifier: Apache-2.0
cmake_minimum_required(VERSION 3.20.0)
find_package(Zephyr REQUIRED HINTS $ENV{ZEPHYR_BASE})
project(stage10_console)

target_sources(app PRIVATE src/main.c)
```

## prj.conf
```kconfig
# UART console and character input/output API.
CONFIG_SERIAL=y
CONFIG_CONSOLE=y
CONFIG_UART_CONSOLE=y
CONFIG_CONSOLE_SUBSYS=y
CONFIG_CONSOLE_GETCHAR=y

# One receiver: Console owns UART input in this application.
CONFIG_SHELL=n
CONFIG_CONSOLE_GETLINE=n
CONFIG_CONSOLE_HANDLER=n

# Only startup/error messages use printk; no logging backend.
CONFIG_PRINTK=y
CONFIG_LOG=n
```

## src/main.c
```c
/* SPDX-License-Identifier: Apache-2.0 */
#include <zephyr/console/console.h>
#include <zephyr/sys/printk.h>

int main(void)
{
	int ret = console_init();

	if (ret < 0) {
		printk("console_init failed: %d\n", ret);
		return ret;
	}

	printk("Stage 10: Console character echo\n");
	printk("Type one letter without Enter.\n");

	while (1) {
		int c = console_getchar();

		if (c < 0) {
			printk("console_getchar failed: %d\n", c);
			return c;
		}

		ret = console_putchar((char)c);
		if (ret < 0) {
			printk("console_putchar failed: %d\n", ret);
			return ret;
		}
	}
}
```
