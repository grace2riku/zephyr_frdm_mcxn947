## stages/07_ntshell/tests/commands/testcase.yaml
```yaml
tests:
  stage7.commands:
    platform_allow:
      - qemu_cortex_m3
    tags:
      - stage7
      - commands
```

## stages/08_memory_ram/tests/commands/testcase.yaml
```yaml
tests:
  stage8.commands:
    platform_allow:
      - qemu_cortex_m3
    tags:
      - stage8
      - commands
```

## stages/09_register_access/tests/commands/testcase.yaml
```yaml
tests:
  stage9.commands:
    platform_allow:
      - qemu_cortex_m3
    tags:
      - stage9
      - commands
```
